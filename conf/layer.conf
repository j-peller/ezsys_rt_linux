## conf/layer.conf
```bitbake
# We have a conf and classes directory, add to BBPATH
BBPATH .= ":${LAYERDIR}"

# We have recipes-* directories, add to BBFILES
BBFILES += "${LAYERDIR}/recipes-*/*/*.bb \
            ${LAYERDIR}/recipes-*/*/*.bbappend"

BBFILE_COLLECTIONS += "meta-rpi-signalgen"
BBFILE_PATTERN_meta-rpi-signalgen = "^${LAYERDIR}/"
BBFILE_PRIORITY_meta-rpi-signalgen = "6"

LAYERDEPENDS_meta-rpi-signalgen = "core"
LAYERSERIES_COMPAT_meta-rpi-signalgen = "kirkstone"
```
